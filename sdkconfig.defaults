## sdkconfig.defaults
```kconfig
CONFIG_ESPTOOLPY_FLASHSIZE_4MB=y
CONFIG_PARTITION_TABLE_CUSTOM=y
CONFIG_PARTITION_TABLE_CUSTOM_FILENAME="partitions.csv"
CONFIG_HTTPD_WS_SUPPORT=y
CONFIG_LWIP_MAX_SOCKETS=10

# USB-Serial-JTAG console (ESP32-C3 SuperMini has native USB)
CONFIG_ESP_CONSOLE_USB_SERIAL_JTAG=y
```
